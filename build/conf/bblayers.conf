## build/conf/bblayers.conf
```bitbake
# POKY_BBLAYERS_CONF_VERSION is increased each time build/conf/bblayers.conf
# changes incompatibly
POKY_BBLAYERS_CONF_VERSION = "2"

BBPATH = "${TOPDIR}"
BBFILES ?= ""

#Instead of meta-lxde desktop, you can use meta-xfce

BBLAYERS ?= " \
  /home/mozcelikors/pokyRT/poky/meta \
  /home/mozcelikors/pokyRT/poky/meta-poky \
  /home/mozcelikors/pokyRT/poky/meta-yocto-bsp \
  /home/mozcelikors/pokyRT/poky/meta-openembedded/meta-oe \
  /home/mozcelikors/pokyRT/poky/meta-openembedded/meta-multimedia \
  /home/mozcelikors/pokyRT/poky/meta-openembedded/meta-networking \
  /home/mozcelikors/pokyRT/poky/meta-openembedded/meta-python \
  /home/mozcelikors/pokyRT/poky/meta-openembedded/meta-initramfs \
  /home/mozcelikors/pokyRT/poky/meta-lxde \
  /home/mozcelikors/pokyRT/poky/meta-openembedded/meta-gnome \
  /home/mozcelikors/pokyRT/poky/meta-raspberrypi \
  /home/mozcelikors/pokyRT/poky/meta-raspberrypi-rt-sv \
  /home/mozcelikors/pokyRT/poky/meta-embeddev \
  /home/mozcelikors/pokyRT/poky/meta-qt5 \
  /home/mozcelikors/pokyRT/poky/meta-qt5-extra \
  "
```

## conf/bblayers.conf
```bitbake
# POKY_BBLAYERS_CONF_VERSION is increased each time build/conf/bblayers.conf
# changes incompatibly
POKY_BBLAYERS_CONF_VERSION = "2"

BBPATH = "${TOPDIR}"
BBFILES ?= ""

#Instead of meta-lxde desktop, you can use meta-xfce

BBLAYERS ?= " \
  /home/mozcelikors/poky/meta \
  /home/mozcelikors/poky/meta-poky \
  /home/mozcelikors/poky/meta-yocto-bsp \
  /home/mozcelikors/poky/meta-openembedded/meta-oe \
  /home/mozcelikors/poky/meta-openembedded/meta-multimedia \
  /home/mozcelikors/poky/meta-openembedded/meta-networking \
  /home/mozcelikors/poky/meta-openembedded/meta-python \
  /home/mozcelikors/poky/meta-lxde \
  /home/mozcelikors/poky/meta-openembedded/meta-gnome \
  /home/mozcelikors/poky/meta-raspberrypi \
  /home/mozcelikors/poky/meta-embeddev \
  /home/mozcelikors/poky/meta-qt5 \
  /home/mozcelikors/poky/meta-qt5-extra \
  "
```

## meta-embeddev/conf/distro/embeddev.conf
```bitbake
#Change DISTRO in local.conf to use this..!

require conf/distro/poky.conf

DISTRO = "embeddev"
DISTRO_NAME = "Embeddev Distribution"
DISTRO_VERSION = "0.1.0"
DISTRO_CODENAME = "arp"

SDK_VERSION="${DISTRO_VERSION}"
MAINTAINER = "mozcelikors@gmail.com"

TARGET_VENDOR = "-embeddev"
#SDK_VENDOR = "-embeddevsdk"

# Override these in poky based distros
EMBEDDEV_DEFAULT_DISTRO_FEATURES = "x11 wiringPi"
EMBEDDEV_DEFAULT_EXTRA_RDEPENDS = ""
EMBEDDEV_DEFAULT_EXTRA_RRECOMMENDS = ""

PACKAGE_CLASSES ?= "package_ipk"

DISTRO_EXTRA_RDEPENDS += " ${EMBEDDEV_DEFAULT_EXTRA_RDEPENDS}"
DISTRO_EXTRA_RRECOMMENDS += " ${EMBEDDEV_DEFAULT_EXTRA_RRECOMMENDS}"

DISTRO_FEATURES ?= "${EMBEDDEV_DEFAULT_DISTRO_FEATURES} ${DISTRO_FEATURES_LIBC} "
```

## meta-embeddev/conf/layer.conf
```bitbake
# We have a conf and classes directory, add to BBPATH
BBPATH .= ":${LAYERDIR}"

# We have recipes-* directories, add to BBFILES
BBFILES += "${LAYERDIR}/recipes-*/*/*.bb \
            ${LAYERDIR}/recipes-*/*/*.bbappend"

BBFILE_COLLECTIONS += "meta-embeddev"
BBFILE_PATTERN_meta-embeddev = "^${LAYERDIR}/"
BBFILE_PRIORITY_meta-embeddev = "12"

# Following is used to embed initramfs image into kernel. Only can be used in .conf files.
#INITRAMFS_IMAGE="embeddev-initramfs-image"
#INITRAMFS_IMAGE_BUNDLE = "1"
#INITRAMFS_MAXSIZE = "256000"
#KERNEL_INITRAMFS = "-initramfs"

# If you want to generate an overlay:
# Add following to your distro.conf (embeddev.conf)
# Compile and add custom devicetree for TFT display for early module initialization
#KERNEL_DEVICETREE_append = " overlays/rpi-display.dtbo "

## E X P E R I M E N T A L ! ##
# Resource: https://bootlin.com/doc/training/boot-time/boot-time-slides.pdf
####### FOR A SMALLER SIZE KERNEL, SINCE KERNEL TAKES LONG TIME IN RASPBERRY PI!
# If a kernel feature fails, try to undo..
# These changes are done in meta-embeddev/recipes-kernel/linux
# These are features that are not used in user-space, however a kernel developer would need these!!!
#CONFIG_PRINTK=n
#CONFIG_KALLSYMS=n
#CONFIG_DEBUG_FS=n
#CONFIG_BUG=n
#CONFIG_ZERO_BOOTDELAY_CHECK=y  # Add bootdelay=0 to cmdline
#CONFIG_SILENT_CONSOLE=y        # Add silent=1 to cmdline

# Disable boot logo - need to be put on layer.conf
CMDLINE_append = " logo.nologo "

# If you are using splash..
CMDLINE_append = "splash "

# Make the boot faster..
CMDLINE_append = "rootflags=commit=120,data=writeback bootdelay=0 silent=1 elevator=deadline noatime nodiratime data=writeback quiet consoleblank=0 "

TOOLCHAIN_HOST_TASK_append = " nativesdk-cmake nativesdk-glibc nativesdk-cmake-dev "
TOOLCHAIN_TARGET_TASK_append = " cmake wiringpi-dev glibc glibc-utils"
TOOLCHAIN_TARGET_TASK_append = "  opencv-dev raspicam-dev i2c-tools-dev "

DISTRO_FEATURES_remove = " qtwayland wayland "
```
